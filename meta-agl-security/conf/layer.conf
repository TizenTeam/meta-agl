## meta-agl-security/conf/layer.conf
```bitbake
# We have a conf and classes directory, add to BBPATH
BBPATH =. "${LAYERDIR}:"

# We have recipes-* directories, add to BBFILES
BBFILES += "${LAYERDIR}/recipes-*/*/*.bb \
            ${LAYERDIR}/recipes-*/*/*.bbappend"

BBFILE_COLLECTIONS += "agl-security"
BBFILE_PATTERN_agl-security = "^${LAYERDIR}/"
BBFILE_PRIORITY_agl-security = "9"
```
